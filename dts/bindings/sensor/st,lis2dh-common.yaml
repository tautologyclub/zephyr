## dts/bindings/sensor/st,lis2dh-common.yaml
```yaml
# Copyright (c) 2018 STMicroelectronics
# SPDX-License-Identifier: Apache-2.0

properties:
    irq-gpios:
      type: phandle-array
      required: false
      description: |
        The INT1 and (optional) INT2 signal connections.  These signals
        are active-high as produced by the sensor.

    disconnect-sdo-sa0-pull-up:
      type: boolean
      required: false
      description: |
        Indicates the device driver should disconnect SDO/SA0 pull-up
        during device initialization (e.g. to save current
        leakage). Note that only subset of devices supported by this
        binding have SDO/SA0 pull-up (e.g. LIS2DH12, LIS3DH).

    anym-on-int1:
      type: boolean
      required: false
      description: |
        Indicates that the device driver should use interrupt 1
        for any movement. This is for boards that only have one
        interrupt line connected from the sensor to the processor.

    use-hw-fifo:
      type: boolean
      required: false
      description: |
        Indicates that the accelerometer should not trigger DRDY
        interrupts until internal hardware FIFO is filled with 32
        samples. If enabled, the registered DATA_READY handler will
        be called thirty-two times in short succession. For this
        reason, it is recommended to pair this option with
        CONFIG_LIS2DH_TRIGGER_OWN_THREAD=y.
```
